/*
 * Timer.c
 *
 * Created: 14/09/2015 20:40:39
 *  Author: Caio
 */ 

#include <asf.h>
#include "Timer.h"

/** Global timestamp in milliseconds since start of application */
volatile uint32_t g_ul_ms_ticks = 0;
volatile uint8_t flag_time_sample = 0;
static uint32_t cont_ticks = 0;

/**
 *  \brief Handler for System Tick interrupt.
 *
 *  Process System Tick Event
 *  increments the timestamp counter.
 */
void SysTick_Handler(void){
	g_ul_ms_ticks++;
	
	if ( (g_ul_ms_ticks - cont_ticks) >= TIME_SAMPLE ){
		flag_time_sample = 1;
		cont_ticks = g_ul_ms_ticks;
	}
}

/**
 *  \brief Wait for the given number of milliseconds (using the dwTimeStamp
 *         generated by the SAM microcontrollers' system tick).
 *  \param ul_dly_ticks  Delay to wait for, in milliseconds.
 */
void mdelay(uint32_t ul_dly_ticks){
	uint32_t ul_cur_ticks;

	ul_cur_ticks = g_ul_ms_ticks;
	while ((g_ul_ms_ticks - ul_cur_ticks) < ul_dly_ticks);
}

uint8_t get_flag_sample(void){
	return flag_time_sample;
}

void set_flag_sample(uint8_t flag){
	flag_time_sample = flag;
}

void config_timer(void){
	//CONFIGURADO PARA 0,1 ms (sysclk_get_cpu_hz() / 10000)
	if (SysTick_Config(sysclk_get_cpu_hz() / TIMER_CONSTANT)) {
		puts("-E- Systick configuration error\r");
		while (1) {
			/* Capture error */
			gpio_set_pin_low(LED2_GPIO);
		}
	}
}